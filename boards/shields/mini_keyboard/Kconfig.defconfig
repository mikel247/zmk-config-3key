## boards/shields/mini_keyboard/dts/bindings/zmk,behavior-custom-random.yaml
```yaml
# zmk,behavior-custom-random.yaml
description: Custom Random Number Generator

compatible: "zmk,behavior-custom-random"

properties:
  "#binding-cells":
    type: int
    const: 2
  label:
    type: string
```

## boards/shields/mini_keyboard/dts/bindings/zmk,behavior-rng-final.yaml
```yaml
description: Custom Random Number Generator
compatible: "zmk,behavior-rng-final" # Changed here
properties:
  "#binding-cells":
    type: int
    const: 2
```

## config/west.yml
```yaml
manifest:
  defaults:
    revision: main
  remotes:
    - name: zmkfirmware
      url-base: https://github.com/zmkfirmware
    - name: mikel247 # Replace with your GitHub username
      url-base: https://github.com/mikel247
  projects:
    - name: zmk
      remote: zmkfirmware
      import: app/west.yml
    - name: zmk-behavior-random # This must match your module repo name
      remote: mikel247
      revision: main
  self:
    path: config
```
